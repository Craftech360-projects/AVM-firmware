## CMakeLists.txt
```
# SPDX-License-Identifier: Apache-2.0

cmake_minimum_required(VERSION 3.20.0)
find_package(Zephyr REQUIRED HINTS $ENV{ZEPHYR_BASE})
project(nrf52840_nordic)
enable_language(C ASM)

target_sources(app PRIVATE
    src/main.c
    src/transport.c
    src/mic.c
    src/led.c
    src/audio.c
    src/codec.c
    src/controls.c
    src/battery.c
    src/settings.c
)

target_sources_ifdef(CONFIG_BUBBLE_CODEC_OPUS app PRIVATE
    src/opus-1.2.1/A2NLSF.c
    src/opus-1.2.1/CNG.c
    src/opus-1.2.1/HP_variable_cutoff.c
    src/opus-1.2.1/LPC_analysis_filter.c
    src/opus-1.2.1/LPC_fit.c
    src/opus-1.2.1/LPC_inv_pred_gain.c
    src/opus-1.2.1/LP_variable_cutoff.c
    src/opus-1.2.1/LTP_analysis_filter_FIX.c
    src/opus-1.2.1/LTP_scale_ctrl_FIX.c
    src/opus-1.2.1/NLSF2A.c
    src/opus-1.2.1/NLSF_VQ.c
    src/opus-1.2.1/NLSF_VQ_weights_laroia.c
    src/opus-1.2.1/NLSF_decode.c
    src/opus-1.2.1/NLSF_del_dec_quant.c
    src/opus-1.2.1/NLSF_encode.c
    src/opus-1.2.1/NLSF_stabilize.c
    src/opus-1.2.1/NLSF_unpack.c
    src/opus-1.2.1/NSQ.c
    src/opus-1.2.1/NSQ_del_dec.c
    src/opus-1.2.1/PLC.c
    src/opus-1.2.1/VAD.c
    src/opus-1.2.1/VQ_WMat_EC.c
    src/opus-1.2.1/ana_filt_bank_1.c
    src/opus-1.2.1/analysis.c
    src/opus-1.2.1/apply_sine_window_FIX.c
    src/opus-1.2.1/autocorr_FIX.c
    src/opus-1.2.1/bands.c
    src/opus-1.2.1/biquad_alt.c
    src/opus-1.2.1/burg_modified_FIX.c
    src/opus-1.2.1/bwexpander.c
    src/opus-1.2.1/bwexpander_32.c
    src/opus-1.2.1/celt.c
    src/opus-1.2.1/celt_decoder.c
    src/opus-1.2.1/celt_encoder.c
    src/opus-1.2.1/celt_lpc.c
    src/opus-1.2.1/arm/celt_pitch_xcorr_arm_gcc.s
    src/opus-1.2.1/check_control_input.c
    src/opus-1.2.1/code_signs.c
    src/opus-1.2.1/control_SNR.c
    src/opus-1.2.1/control_audio_bandwidth.c
    src/opus-1.2.1/control_codec.c
    src/opus-1.2.1/corrMatrix_FIX.c
    src/opus-1.2.1/cwrs.c
    src/opus-1.2.1/debug.c
    src/opus-1.2.1/dec_API.c
    src/opus-1.2.1/decode_core.c
    src/opus-1.2.1/decode_frame.c
    src/opus-1.2.1/decode_indices.c
    src/opus-1.2.1/decode_parameters.c
    src/opus-1.2.1/decode_pitch.c
    src/opus-1.2.1/decode_pulses.c
    src/opus-1.2.1/decoder_set_fs.c
    src/opus-1.2.1/enc_API.c
    src/opus-1.2.1/encode_frame_FIX.c
    src/opus-1.2.1/encode_indices.c
    src/opus-1.2.1/encode_pulses.c
    src/opus-1.2.1/entcode.c
    src/opus-1.2.1/entdec.c
    src/opus-1.2.1/entenc.c
    src/opus-1.2.1/find_LPC_FIX.c
    src/opus-1.2.1/find_LTP_FIX.c
    src/opus-1.2.1/find_pitch_lags_FIX.c
    src/opus-1.2.1/find_pred_coefs_FIX.c
    src/opus-1.2.1/gain_quant.c
    src/opus-1.2.1/init_decoder.c
    src/opus-1.2.1/init_encoder.c
    src/opus-1.2.1/inner_prod_aligned.c
    src/opus-1.2.1/interpolate.c
    src/opus-1.2.1/k2a_FIX.c
    src/opus-1.2.1/k2a_Q16_FIX.c
    src/opus-1.2.1/kiss_fft.c
    src/opus-1.2.1/laplace.c
    src/opus-1.2.1/lin2log.c
    src/opus-1.2.1/log2lin.c
    src/opus-1.2.1/mathops.c
    src/opus-1.2.1/mdct.c
    src/opus-1.2.1/mlp.c
    src/opus-1.2.1/mlp_data.c
    src/opus-1.2.1/modes.c
    src/opus-1.2.1/noise_shape_analysis_FIX.c
    src/opus-1.2.1/opus.c
    src/opus-1.2.1/opus_decoder.c
    src/opus-1.2.1/opus_encoder.c
    src/opus-1.2.1/opus_multistream.c
    src/opus-1.2.1/opus_multistream_decoder.c
    src/opus-1.2.1/opus_multistream_encoder.c
    src/opus-1.2.1/pitch.c
    src/opus-1.2.1/pitch_analysis_core_FIX.c
    src/opus-1.2.1/pitch_est_tables.c
    src/opus-1.2.1/process_NLSFs.c
    src/opus-1.2.1/process_gains_FIX.c
    src/opus-1.2.1/quant_LTP_gains.c
    src/opus-1.2.1/quant_bands.c
    src/opus-1.2.1/rate.c
    src/opus-1.2.1/regularize_correlations_FIX.c
    src/opus-1.2.1/repacketizer.c
    src/opus-1.2.1/resampler.c
    src/opus-1.2.1/resampler_down2.c
    src/opus-1.2.1/resampler_down2_3.c
    src/opus-1.2.1/resampler_private_AR2.c
    src/opus-1.2.1/resampler_private_IIR_FIR.c
    src/opus-1.2.1/resampler_private_down_FIR.c
    src/opus-1.2.1/resampler_private_up2_HQ.c
    src/opus-1.2.1/resampler_rom.c
    src/opus-1.2.1/residual_energy16_FIX.c
    src/opus-1.2.1/residual_energy_FIX.c
    src/opus-1.2.1/schur64_FIX.c
    src/opus-1.2.1/schur_FIX.c
    src/opus-1.2.1/shell_coder.c
    src/opus-1.2.1/sigm_Q15.c
    src/opus-1.2.1/sort.c
    src/opus-1.2.1/stereo_LR_to_MS.c
    src/opus-1.2.1/stereo_MS_to_LR.c
    src/opus-1.2.1/stereo_decode_pred.c
    src/opus-1.2.1/stereo_encode_pred.c
    src/opus-1.2.1/stereo_find_predictor.c
    src/opus-1.2.1/stereo_quant_pred.c
    src/opus-1.2.1/sum_sqr_shift.c
    src/opus-1.2.1/table_LSF_cos.c
    src/opus-1.2.1/tables_LTP.c
    src/opus-1.2.1/tables_NLSF_CB_NB_MB.c
    src/opus-1.2.1/tables_NLSF_CB_WB.c
    src/opus-1.2.1/tables_gain.c
    src/opus-1.2.1/tables_other.c
    src/opus-1.2.1/tables_pitch_lag.c
    src/opus-1.2.1/tables_pulses_per_block.c
    src/opus-1.2.1/vector_ops_FIX.c
    src/opus-1.2.1/vq.c
    src/opus-1.2.1/warped_autocorrelation_FIX.c
    src/opus-1.2.1/arm/celt_pitch_xcorr_arm_gcc.s
)

set(CMAKE_C_FLAGS "${CMAKE_C_FLAGS} -DARM_MATH_CM4")
# set(CMAKE_C_FLAGS "${CMAKE_C_FLAGS} -DVAR_ARRAYS")
set(CMAKE_C_FLAGS "${CMAKE_C_FLAGS} -DOPUS_ARM_ASM")
set(CMAKE_C_FLAGS "${CMAKE_C_FLAGS} -DOPUS_ARM_INLINE_ASM")
set(CMAKE_C_FLAGS "${CMAKE_C_FLAGS} -DOPUS_ARM_INLINE_EDSP")
set(CMAKE_C_FLAGS "${CMAKE_C_FLAGS} -DOPUS_ARM_INLINE_MEDIA")
set(CMAKE_C_FLAGS "${CMAKE_C_FLAGS} -DOPUS_ARM_MAY_HAVE_EDSP")
set(CMAKE_C_FLAGS "${CMAKE_C_FLAGS} -DOPUS_ARM_PRESUME_EDSP")
set(CMAKE_C_FLAGS "${CMAKE_C_FLAGS} -DOPUS_BUILD")
set(CMAKE_C_FLAGS "${CMAKE_C_FLAGS} -DUSE_ALLOCA")
set(CMAKE_C_FLAGS "${CMAKE_C_FLAGS} -DFIXED_POINT -DDISABLE_FLOAT_API")
set(CMAKE_C_FLAGS "${CMAKE_C_FLAGS} -DHAVE_CONFIG_H")
set(CMAKE_C_FLAGS "${CMAKE_C_FLAGS} -DHAVE_ALLOCA_H")
set(CMAKE_C_FLAGS "${CMAKE_C_FLAGS} -fsingle-precision-constant") # A lot of constants are written as doubles
set(CMAKE_C_FLAGS "${CMAKE_C_FLAGS} -DHAVE_LRINT -DHAVE_LRINTF")
```

## prj.conf
```kconfig
#
# Firmware settings
#

CONFIG_BUBBLE_SOFT_BUTTON=y

#
# Hardware settings
#

# Microphone
CONFIG_NRFX_PDM=y
CONFIG_ADC=y

# Watchdog
CONFIG_WATCHDOG=y
CONFIG_WDT_NRFX=y

# Storage
CONFIG_NVS=y
CONFIG_FLASH=y
CONFIG_FLASH_MAP=y
CONFIG_SETTINGS=y
CONFIG_SETTINGS_NVS=y
CONFIG_SETTINGS_RUNTIME=y

#
# Bluetooth settings
#

CONFIG_BT=y
CONFIG_BT_PERIPHERAL=y
CONFIG_BT_DEVICE_NAME="Friend"
# This is important since our code assumes a single connection
CONFIG_BT_MAX_CONN=1
CONFIG_BT_MAX_PAIRED=1
CONFIG_BT_DEVICE_APPEARANCE=22
CONFIG_BT_GATT_DYNAMIC_DB=y

# Pairing
# CONFIG_BT_SMP=y

# Coded PHY (long range) doesnt work with Apple
# CONFIG_BT_CTLR_PHY_CODED=y
# CONFIG_BT_CTLR_CONN_PARAM_REQ=y

# Alternative BLE implementation
# CONFIG_BT_LL_SW_SPLIT=y

# MOAR POWER
CONFIG_BT_CTLR_TX_PWR_ANTENNA=8
CONFIG_BT_PHY_UPDATE=y

# Large packets
CONFIG_BT_L2CAP_TX_MTU=498
CONFIG_BT_L2CAP_TX_BUF_COUNT=10
CONFIG_BT_CONN_TX_MAX=30
CONFIG_BT_BUF_ACL_RX_SIZE=2048
CONFIG_BT_BUF_ACL_TX_SIZE=2048
CONFIG_BT_CTLR_DATA_LENGTH_MAX=251
CONFIG_BT_USER_DATA_LEN_UPDATE=y
CONFIG_BT_AUTO_DATA_LEN_UPDATE=y
CONFIG_BT_USER_PHY_UPDATE=y
CONFIG_BT_AUTO_PHY_UPDATE=y
CONFIG_BT_RX_STACK_SIZE=4096

# Codecs (not implemented)
# CONFIG_LIBLC3=y

# Camera
# CONFIG_I2C=y
# CONFIG_SPI=y

# Debug
# CONFIG_DEBUG=y
CONFIG_ASSERT=y # DO NOT DISABLE - will cause hard fault
# CONFIG_LOG=y
# CONFIG_LOG_PRINTK=y
# CONFIG_LOG_BUFFER_SIZE=4096
# CONFIG_LOG_PROCESS_THREAD_STACK_SIZE=4096
# CONFIG_LOG_MODE_IMMEDIATE=y

# Log Levels
# CONFIG_BT_DEBUG_LOG=y
# CONFIG_BT_L2CAP_LOG_LEVEL_DBG=y
# CONFIG_BT_LOG_LEVEL_DBG=y

# CONFIG_LOG_PROCESS_THREAD_STACK_SIZE=4096
# CONFIG_BT_CTLR_RX_PRIO_STACK_SIZE=4096
# CONFIG_BT_DEBUG_LOG=y
# CONFIG_LOG_BUFFER_SIZE=32000
# CONFIG_LOG_OVERRIDE_LEVEL=4
# CONFIG_LOG_PROCESS_THREAD_STACK_SIZE=4096
# CONFIG_BT_RX_STACK_SIZE=4096
# CONFIG_BT_CTLR_RX_PRIO_STACK_SIZE=4096

# RTT
# CONFIG_UART_CONSOLE=n
# CONFIG_SEGGER_RTT_BUFFER_SIZE_UP=2048
# CONFIG_RTT_CONSOLE=y
# CONFIG_LOG_BACKEND_RTT=y
```

## src/main.c
```c
#include <zephyr/kernel.h>
#include <zephyr/drivers/watchdog.h>
#include <zephyr/drivers/gpio.h>
#include "transport.h"
#include "mic.h"
#include "utils.h"
#include "led.h"
#include "config.h"
#include "audio.h"
#include "codec.h"
#include "controls.h"
#include "battery.h"
#include "settings.h"

// State
#ifdef ENABLE_BUTTON
bool is_allowed = true;
#else
#define is_allowed true
#endif
bool is_recording = false;
bool is_connected = false;
bool is_charging = false;
void refresh_state_indication();

//
// Mic State
//

static void update_mic_if_needed()
{
	if (is_allowed && is_connected && !is_recording)
	{
		is_recording = true;
		mic_resume();
	}
	if ((!is_allowed || !is_connected) && is_recording)
	{
		is_recording = false;
		mic_pause();
	}
}

//
// Transport callbacks
//

static void transport_subscribed()
{
	is_connected = true;
	update_mic_if_needed();
	refresh_state_indication();
}

static void transport_unsubscribed()
{
	is_connected = false;
	update_mic_if_needed();
	refresh_state_indication();
}

static struct transport_cb transport_callbacks = {
	.subscribed = transport_subscribed,
	.unsubscribed = transport_unsubscribed,
};

//
// Button
//

#ifdef ENABLE_BUTTON
static void on_button_pressed()
{
	// Update allowed flag
	is_allowed = !is_allowed;
	set_allowed(is_allowed);
	settings_write_enable(is_allowed);
	printk("Mic allowed: %d\n", is_allowed);

	// Update mic
	update_mic_if_needed();

	// Refresh LED
	refresh_state_indication();
}
#endif

//
// Audio Pipeline
//

static void codec_handler(uint8_t *data, size_t len)
{
	broadcast_audio_packets(data, len); // Errors are logged inside
}

static void mic_handler(int16_t *buffer)
{
	codec_receive_pcm(buffer, MIC_BUFFER_SAMPLES); // Errors are logged inside
}

//
// LED indication
//

void refresh_state_indication()
{
	// Recording and connected state - BLUE
	if (is_allowed && is_recording)
	{
		set_led_red(false);
		set_led_green(false);
		set_led_blue(true);
		return;
	}

	// Recording but lost connection - RED
	if (is_allowed && !is_recording)
	{
		set_led_red(true);
		set_led_green(false);
		set_led_blue(false);
		return;
	}

	// Not recording, but charging - WHITE
	if (is_charging)
	{
		set_led_red(true);
		set_led_green(true);
		set_led_blue(true);
		return;
	}

	// Not recording - OFF
	set_led_red(false);
	set_led_green(false);
	set_led_blue(false);
}

//
// Main
//

int main(void)
{
	// Start watchdog
	int err;
	struct wdt_timeout_cfg wdt_config;
	const struct device *wdt_dev = DEVICE_DT_GET(DT_NODELABEL(wdt));
	wdt_config.flags = WDT_FLAG_RESET_SOC;
	wdt_config.window.min = 0;
	wdt_config.window.max = WDT_TIMEOUT_MS;
	wdt_config.callback = NULL; // Set to NULL to cause a system reset
	ASSERT_OK(wdt_install_timeout(wdt_dev, &wdt_config));
	ASSERT_OK(wdt_setup(wdt_dev, WDT_OPT_PAUSE_HALTED_BY_DBG));

	// Led start
	ASSERT_OK(led_start());

	// Settings start
	ASSERT_OK(settings_start());
#ifdef ENABLE_BUTTON
	is_allowed = settings_read_enable();
#endif
	ASSERT_OK(wdt_feed(wdt_dev, 0));

	// Battery start
	ASSERT_OK(battery_start());
	ASSERT_OK(wdt_feed(wdt_dev, 0));

	// Transport start
	set_transport_callbacks(&transport_callbacks);
	ASSERT_OK(transport_start());
	set_allowed(is_allowed);
	ASSERT_OK(wdt_feed(wdt_dev, 0));

#if 0
	// Controls
#ifdef ENABLE_BUTTON
	set_button_handler(on_button_pressed);
	ASSERT_OK(start_controls());
#endif
#endif

	ASSERT_OK(wdt_feed(wdt_dev, 0));

	// Codec start
	set_codec_callback(codec_handler);
	ASSERT_OK(codec_start());
	ASSERT_OK(wdt_feed(wdt_dev, 0));

	// Mic start
	set_mic_callback(mic_handler);
	ASSERT_OK(mic_start());
	update_mic_if_needed();
	ASSERT_OK(wdt_feed(wdt_dev, 0));

	// Set LED
	is_charging = is_battery_charging();
	refresh_state_indication();
	ASSERT_OK(wdt_feed(wdt_dev, 0));

	// Main loop
	while (1)
	{
		// Wait wdt
		k_msleep(WDT_FEED_MS);

		// Watchdog
		ASSERT_OK(wdt_feed(wdt_dev, 0));

		// Update battery state
		bool charging = is_battery_charging();
		if (charging != is_charging)
		{
			is_charging = charging;
			refresh_state_indication();
		}
	}

	// Unreachable
	return 0;
}
```
